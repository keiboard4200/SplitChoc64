#include "splitchoc64.dtsi"

&kscan0 {
    /* LEFT Ver001 peripheral: COL0..5 = D10,D11,D12,D13,D14,D15 */
    col-gpios
        = <&gpio1 15 GPIO_ACTIVE_HIGH>
        , <&gpio0 15 GPIO_ACTIVE_HIGH>
        , <&gpio0 19 GPIO_ACTIVE_HIGH>
        , <&gpio1 1 GPIO_ACTIVE_HIGH>
        , <&gpio0 9 GPIO_ACTIVE_HIGH>
        , <&gpio0 10 GPIO_ACTIVE_HIGH>
        ;
};
