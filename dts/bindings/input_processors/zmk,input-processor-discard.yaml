## dts/bindings/input_processors/zmk,input-processor-discard.yaml
```yaml
description: Drop an input event and stop further processing

compatible: "zmk,input-processor-discard"

include: base.yaml

properties:
  "#input-processor-cells":
    type: int
    const: 0
```

## dts/bindings/zmk,input-processor-discard.yaml
```yaml
description: Drop an input event and stop further processing
compatible: "zmk,input-processor-discard"

properties:
  "#input-processor-cells":
    type: int
    const: 0
```

## firmware/joystick/boards/shields/splitchoc64/Kconfig.defconfig
```kconfig
if SHIELD_SPLITCHOC64_RIGHT

config ZMK_KEYBOARD_NAME
    default "SplitChoc64"

config ZMK_SPLIT_ROLE_CENTRAL
    default y

endif

if SHIELD_SPLITCHOC64_LEFT || SHIELD_SPLITCHOC64_RIGHT

config ZMK_SPLIT
    default y

endif
```

## firmware/joystick/dts/bindings/input_processors/zmk,input-processor-discard.yaml
```yaml
description: Drop an input event and stop further processing

compatible: "zmk,input-processor-discard"

include: base.yaml

properties:
  "#input-processor-cells":
    type: int
    const: 0

  track-remainders:
    type: boolean
    description: Whether this processor requires fractional remainder tracking
```

## software/west.yml
```yaml
manifest:
  remotes:
    - name: zmkfirmware
      url-base: https://github.com/zmkfirmware
    - name: sekigon-gonnoc
      url-base: https://github.com/sekigon-gonnoc
  projects:
    - name: zmk
      remote: zmkfirmware
      revision: 641514a97db345f499dd50b0360e594270f008fe
      import: app/west.yml
    - name: zmk-driver-paw3222
      remote: sekigon-gonnoc
      revision: main
  self:
    path: config
```

## software/zmk-module/boards/shields/splitchoc64/Kconfig.shield
```kconfig
config SHIELD_SPLITCHOC64_LEFT
    def_bool $(shields_list_contains,splitchoc64_left)

config SHIELD_SPLITCHOC64_RIGHT
    def_bool $(shields_list_contains,splitchoc64_right)
```

## software/zmk-module/dts/bindings/behaviors/splitchoc64,behavior-joy-config.yaml
```yaml
description: SplitChoc64 runtime joystick configuration behavior

compatible: "splitchoc64,behavior-joy-config"

include: zero_param.yaml

properties:
  command:
    type: int
    required: true
```

## software/zmk-module/dts/bindings/behaviors/zmk,behavior-mouse-button-toggle.yaml
```yaml
description: Toggle a mouse button state on each behavior press

compatible: "zmk,behavior-mouse-button-toggle"

include: zero_param.yaml
```

## software/zmk-module/dts/bindings/behaviors/zmk,behavior-paw3222-cpi.yaml
```yaml
description: Adjust PAW3222 CPI relative to the sensor's current register value

compatible: "zmk,behavior-paw3222-cpi"

include: one_param.yaml
```
